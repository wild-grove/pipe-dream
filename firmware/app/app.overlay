#include <zephyr/dt-bindings/pinctrl/cc13xx_cc26xx-pinctrl.h>

&pinctrl {
	gpt0_pwm: gpt0_pwm {
		pinmux = <23 IOC_PORT_MCU_PORT_EVENT1>;
		bias-disable;
		drive-strength = <8>;
	};
};

&gpt0 {
	status = "okay";
};

&pwm0 {
	status = "okay";
	pinctrl-0 = <&gpt0_pwm>;
	pinctrl-names = "default";
};
